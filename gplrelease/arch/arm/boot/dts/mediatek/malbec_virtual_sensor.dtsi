/*
 * Copyright (C) 2020-2021 Amazon Technologies Inc. All rights reserved.
 *
 * This program is free software; you can redistribute it and/or modify
 * it under the terms of the GNU General Public License version 2 as
 * published by the Free Software Foundation.
 *
 * This program is distributed in the hope that it will be useful,
 * MERCHANTABILITY or FITNESS FOR A PARTICULAR PURPOSE.  See the
 * GNU General Public License for more details.
 */

vs0: vs0 {
	compatible = "amazon,vs0_wpc", "simple-bus";

	/*
	 * Virtual sensor
	 * select_device: Decide to register which thermal_zone device
	 * 0: register to thermal_zone7
	 */
	virtual_sensor@0{
		compatible = "amazon,virtual_sensor_thermal";
		dev_id = <0>;
		num_trips = <4>;
		mode = <0>;
		polling_delay = <2000>;
		governor_name = "virtual_sensor";
		num_tbps = <1>;
		temp = <40000 42000 45000 48000 60000 60000 60000 60000 60000 60000 60000 60000>;
		type = <0 0 0 0 0 0 0 0 0 0 0 0>;
		hyst = <1000 1000 1000 1000 0 0 0 0 0 0 0 0>;
		num_cdevs = <1>;
		cdev_names = "wpc_bcct0";
	};

	/* WPC Battery Current Cooler */
	wpc_bcct@0 {
		compatible = "amazon,virtual_sensor_cooler";
		type = "wpc_bcct0";
		state = <0>;
		max_state = <4>;
		level = <1500>;
		max_level = <1500>;
		thermal_cooler_id = <0>;
		levels = <1000 500 200 0 0 0 0 0 0 0 0 0>;
	};

	/* Virtual sensor WPC */
	thermistor_wpc@0 {
		compatible = "amazon,virtual_sensor_thermal_sensor";
		thermal_sensor,offset = <0>;
		thermal_sensor,offset_invert = <0>;
		thermal_sensor,alpha = <1000>;
		thermal_sensor,weight = <1000>;
		thermal_sensor,weight_invert = <0>;
		thermal_sensor_id = <6>;
		aux_channel_num = <0>;
		select_device = <0>;
	};
};

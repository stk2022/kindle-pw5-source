/*
 * SPDX-License-Identifier: (GPL-2.0 OR MIT)
 */
#include "aud8110p2-d1.dts"


&mmc0 {
	compatible = "falcon_blk";
};


/ {
	falcon {
		falcon-bios = <0xdf9a0000 0x50000>;
		storage-bios = <0xdf980000 0x20000>;
		work-size = <0x0>;

		storage = <&mmc0>;
		storage-name = "mt8110a-falcon-mmc";
		max_seg_size =             <(0xFF00 * 512)>;
		max_hw_segs = /bits/ 16    <512>;
		max_phys_segs = /bits/ 16  <512>;
		max_req_size =             <(0xFF00 * 512)>;
		max_blk_size =             <512>;
		max_blk_count =            <(0xFF00 * 512 / 512)>;
		irq = <(-1)>;
		dma_mask =                 <0x0 0xffffffff>;
		heads = /bits/ 8           <0x4>;
		sectors = /bits/ 8         <0x10>;
		max_discard_sectors =      <0x0>;
		discard_granularity =      <0x0>;
	};

};

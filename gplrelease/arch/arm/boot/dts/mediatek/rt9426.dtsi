/*
 * Copyright (C) 2019 MediaTek Inc.
 *
 * This program is free software; you can redistribute it and/or modify
 * it under the terms of the GNU General Public License version 2 as
 * published by the Free Software Foundation.
 *
 * This program is distributed in the hope that it will be useful,
 * but WITHOUT ANY WARRANTY; without even the implied warranty of
 * MERCHANTABILITY or FITNESS FOR A PARTICULAR PURPOSE.
 * See http://www.gnu.org/licenses/gpl-2.0.html for more details.
 */

&rt9426 {
	rt,dtsi_version = <01 925>;
	rt,battery_type = <4200>;
	rt,volt_source = <3>; /* 0:AP 1:FG_VBAT 2:FG_OCV; 3:FG_AV */
	rt,temp_source = <1>; /* 0:AP 1:FG_TEMP 2:FG_INTT; 3:FG_AT */
	rt,curr_source = <2>; /* 0:AP 1:FG_CURR 2:FG_AI */
	rt,offset_interpolation_order = <2 2>;
	rt,soc_offset_size = <2 1>;
	rt,soc_offset_data = < 0 250 0 1000 250 0>;
	rt,extreg_size = <20>;
	rt,extreg_data = <
		0x5 0x46 0x4105
		0x5 0x48 0x0319
		0x5 0x4E 0x0005
		0x6 0x4E 0x0810
		0x7 0x40 0x0709
		0x7 0x42 0x0404
		0x7 0x44 0x0404
		0x7 0x46 0x0000
		0x7 0x48 0xFEFF
		0x7 0x4A 0x0303
		0x7 0x4C 0x0003
		0x7 0x4E 0xFDFF
		0x8 0x40 0x00FC
		0x8 0x42 0x0000
		0x8 0x44 0xEFEF
		0x8 0x46 0xEBEC
		0x8 0x48 0xEEEE
		0x8 0x4A 0xE4EE
		0x8 0x4C 0xDEE4
		0x8 0x4E 0x00D8>;
	rt,design_capacity = <6000>;
	rt,fcc = <5682>;
	rt,fg_fc_vth = <0x70>;
	rt,fg_fc_ith = <0x1B>;
	rt,fg_fc_sth = <0x05>;
	rt,fg_fd_vth = <0xA1>;
	rt,fg_op_config = <0x7480 0x0201 0x3FFF 0x0008 0x0B3F>;
	rt,fg_otc_tth = <0x0064>;
	rt,fg_otc_chg_ith = <0x0B5F>;
	rt,fg_otd_tth = <0x0064>;
	rt,fg_otd_dchg_ith = <0x0B5F>;
	rt,fg_uvov_threshold = <0x00FF>;
	rt,fg_us_threshold = <0x00>;
	rt,fg_curr_db = <0x05>;
	rt,fg_ocv_table = <0x0013 0x4D80 0x5280 0x53AD 0x54A0 0x5526 0x573A
			   0x58FA 0x5B46 0x5CB3 0x5E1A 0x5F33 0x6026 0x61FA
			   0x63E0 0x652D 0x65E0 0x667A 0x6800 0x6B80 0x1400
			   0x012D 0x00BB 0x008D 0x0088 0x005D 0x0049 0x0056
			   0x0085 0x0098 0x008B 0x005D 0x0077 0x0088 0x0055
			   0x0044 0x0071 0x0166 0x0013 0xFF80 0x0000 0x0200
			   0x049A 0x0680 0x0E4D 0x17E6 0x281A 0x309A 0x3600
			   0x39B3 0x3D33 0x474D 0x4F80 0x5466 0x589A 0x5D1A
			   0x6400 0x6900 0x000D 0x00DA 0x015E 0x01CF 0x01E1
			   0x02BE 0x0386 0x02FC 0x01EE 0x01AF 0x01D8 0x02C4
			   0x0228 0x01E2 0x0300 0x03C0 0x0243 0x00B7 0x3D9E
			   0x0000 0x0000 0x0000>;
};

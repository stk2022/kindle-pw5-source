## gplrelease/Documentation/devicetree/bindings/regulator/rohm,bd71828-regulator.txt
```
ROHM BD71828 Power Management Integrated Circuit regulator bindings

Required properties:
 - regulator-name: should be "buck1", ..., "buck7", and "ldo1", ..., "ldo7"

List of regulators provided by this controller. BD71828 regulators node
should be sub node of the BD71828 MFD node. See BD71828 MFD bindings at
Documentation/devicetree/bindings/mfd/rohm,bd71828-pmic.txt
Regulator nodes should be named to BUCK_<number> and LDO_<number>. The
definition for each of these nodes is defined using the standard
binding for regulators at
Documentation/devicetree/bindings/regulator/regulator.txt.

The valid names for BD71828 regulator nodes are:
BUCK1, BUCK2, BUCK3, BUCK4, BUCK5, BUCK6, BUCK7
LDO1, LDO2, LDO3, LDO4, LDO5, LDO6, LDO7

Optional properties:
- rohm,dvs-run-voltage		: PMIC default "RUN" state voltage in uV.
				  See below table for bucks which support this.
- rohm,dvs-idle-voltage		: PMIC default "IDLE" state voltage in uV.
				  See below table for bucks which support this.
- rohm,dvs-suspend-voltage	: PMIC default "SUSPEND" state voltage in uV.
				  See below table for bucks which support this.
- rohm,dvs-lpsr-voltage		: PMIC default "LPSR" state voltage in uV.
- rohm,dvs-runlvl-ctrl		: buck control is done based on run-level.
				  Regulator is not individually controllable.
				  See ../mfd/rohm,bd71828-pmic.txt for how to
				  specify run-level control mechanism. Only
				  bucks 1, 2, 6 and 7 support this.
- rohm,dvs-runlevel0-voltage    : voltage for run-level 0. Microvolts.
- rohm,dvs-runlevel1-voltage	: voltage for run-level 1. Microvolts.
- rohm,dvs-runlevel2-voltage	: voltage for run-level 2. Microvolts.
- rohm,dvs-runlevel3-voltage	: voltage for run-level 3. Microvolts.

- Any optional property defined in bindings/regulator/regulator.txt

Supported default DVS states:

buck		| run		| idle		| suspend	| lpsr
-----------------------------------------------------------------------------
1, 2, 6, and 7	| supported	| supported	| 	supported (*)
----------------------------------------------------------------------------
3, 4, and 5	| 			supported (**)
----------------------------------------------------------------------------
(*)  LPSR and SUSPEND states use same voltage but both states have own enable /
     disable settings. Voltage 0 can be specified for a state to make regulator
     disabled on that state.
(**) All states use same voltage but have own enable / disable settings. Voltage
     0 can be specified for a state to make regulator disabled on that state.

Example:
regulators {
	buck1: BUCK1 {
		regulator-name = "buck1";
		regulator-min-microvolt = <500000>;
		regulator-max-microvolt = <2000000>;
		regulator-ramp-delay = <2500>;
		rohm,dvs-runlvl-ctrl;
		rohm,dvs-runlevel0-voltage = <500000>;
		rohm,dvs-runlevel1-voltage = <506250>;
		rohm,dvs-runlevel2-voltage = <512500>;
		rohm,dvs-runlevel3-voltage = <518750>;
		regulator-boot-on;
	};
	buck2: BUCK2 {
		regulator-name = "buck2";
		regulator-min-microvolt = <500000>;
		regulator-max-microvolt = <2000000>;
		regulator-ramp-delay = <2500>;
		rohm,dvs-runlvl-ctrl;
		rohm,dvs-runlevel0-voltage = <500000>;
		rohm,dvs-runlevel1-voltage = <506250>;
		rohm,dvs-runlevel2-voltage = <512500>;
		rohm,dvs-runlevel3-voltage = <518750>;
		regulator-boot-on;
	};
	buck3: BUCK3 {
		regulator-name = "buck3";
		regulator-min-microvolt = <1200000>;
		regulator-max-microvolt = <2000000>;
		regulator-boot-on;
	};
	buck4: BUCK4 {
		regulator-name = "buck4";
		regulator-min-microvolt = <1000000>;
		regulator-max-microvolt = <1800000>;
		regulator-boot-on;
	};
	buck5: BUCK5 {
		regulator-name = "buck5";
		regulator-min-microvolt = <2500000>;
		regulator-max-microvolt = <3300000>;
		regulator-boot-on;
	};
	buck6: BUCK6 {
		regulator-name = "buck6";
		regulator-min-microvolt = <500000>;
		regulator-max-microvolt = <2000000>;
		regulator-ramp-delay = <2500>;
		rohm,dvs-runlvl-ctrl;
		rohm,dvs-runlevel0-voltage = <500000>;
		rohm,dvs-runlevel1-voltage = <506250>;
		rohm,dvs-runlevel2-voltage = <512500>;
		rohm,dvs-runlevel3-voltage = <518750>;
		regulator-boot-on;
	};
	buck7: BUCK7 {
		regulator-name = "buck7";
		regulator-min-microvolt = <500000>;
		regulator-max-microvolt = <2000000>;
		regulator-ramp-delay = <2500>;
		rohm,dvs-runlvl-ctrl;
		rohm,dvs-runlevel0-voltage = <500000>;
		rohm,dvs-runlevel1-voltage = <506250>;
		rohm,dvs-runlevel2-voltage = <512500>;
		rohm,dvs-runlevel3-voltage = <518750>;
		regulator-boot-on;
	};
	ldo1: LDO1 {
		regulator-name = "ldo1";
		regulator-min-microvolt = <800000>;
		regulator-max-microvolt = <3300000>;
		regulator-boot-on;
	};
	ldo2: LDO2 {
		regulator-name = "ldo2";
		regulator-min-microvolt = <800000>;
		regulator-max-microvolt = <3300000>;
		regulator-boot-on;
	};
	ldo3: LDO3 {
		regulator-name = "ldo3";
		regulator-min-microvolt = <800000>;
		regulator-max-microvolt = <3300000>;
		regulator-boot-on;
	};
	ldo4: LDO4 {
		regulator-name = "ldo4";
		regulator-min-microvolt = <800000>;
		regulator-max-microvolt = <3300000>;
		regulator-boot-on;
	};
	ldo5: LDO5 {
		regulator-name = "ldo5";
		regulator-min-microvolt = <800000>;
		regulator-max-microvolt = <3300000>;
		regulator-boot-on;
	};
	ldo6: LDO6 {
		regulator-name = "ldo6";
		regulator-min-microvolt = <1800000>;
		regulator-max-microvolt = <1800000>;
		regulator-boot-on;
	};
	ldo7_reg: LDO7 {
		regulator-name = "ldo7";
		regulator-min-microvolt = <800000>;
		regulator-max-microvolt = <3300000>;
		regulator-boot-on;
	};
};
```

## gplrelease/board/mediatek/mt8110/Kconfig
```kconfig
if TARGET_MT8110

config SYS_BOARD
	default "mt8110"

config SYS_CONFIG_NAME
	default "mt8110"


config MTK_BROM_HEADER_INFO
	string
	default "media=nor"

endif
```

## gplrelease/board/mediatek/mt8110_p1/Kconfig
```kconfig
if TARGET_MT8110_P1

config SYS_BOARD
	default "mt8110_p1"

config SYS_CONFIG_NAME
	default "mt8110_p1"


config MTK_BROM_HEADER_INFO
	string
	default "media=nor"

endif
```

## gplrelease/board/mediatek/mt8110_p2_d1/Kconfig
```kconfig
if TARGET_MT8110_P2_D1

config SYS_BOARD
	default "mt8110_p2_d1"

config SYS_CONFIG_NAME
	default "mt8110_p2_d1"


config MTK_BROM_HEADER_INFO
	string
	default "media=nor"

endif
```

## gplrelease/board/mediatek/mt8110_p2_d2/Kconfig
```kconfig
if TARGET_MT8110_P2_D2

config SYS_BOARD
	default "mt8110_p2_d2"

config SYS_CONFIG_NAME
	default "mt8110_p2_d2"


config MTK_BROM_HEADER_INFO
	string
	default "media=nor"

endif
```

## gplrelease/configs/mt8518_ap1_emmc_defconfig
```kconfig
CONFIG_ARM=y
CONFIG_POSITION_INDEPENDENT=y
CONFIG_ARCH_MEDIATEK=y
CONFIG_SYS_TEXT_BASE=0x44E00000
CONFIG_SYS_MALLOC_F_LEN=0x4000
CONFIG_TARGET_MT8518=y
CONFIG_SYS_PROMPT="MT8518> "
CONFIG_NR_DRAM_BANKS=1
CONFIG_DEBUG_UART_BASE=0x11005000
CONFIG_DEBUG_UART_CLOCK=26000000
# CONFIG_PSCI_RESET is not set
CONFIG_DEBUG_UART=y
CONFIG_FIT=y
CONFIG_FIT_SIGNATURE=y
CONFIG_OF_LIBFDT=y
CONFIG_FDT_DEBUG=y
CONFIG_BOARD_LATE_INIT=y
CONFIG_LZMA=y
CONFIG_LZ4=y
CONFIG_LZO=y
CONFIG_GZIP=y
CONFIG_BZIP2=y
CONFIG_CMD_BOOTMENU=y
CONFIG_MENU_SHOW=y
CONFIG_DEFAULT_FDT_FILE="mt8518-ap1-emmc"
CONFIG_DEFAULT_DEVICE_TREE="mt8518-ap1-emmc"
CONFIG_PINCTRL=y
CONFIG_PINCTRL_MT8518=y
CONFIG_RAM=y
CONFIG_BAUDRATE=921600
CONFIG_REGMAP=y
CONFIG_SYSCON=y
CONFIG_DM=y
CONFIG_DM_DEMO=y
CONFIG_DM_RESET=y
CONFIG_DM_DEBUG=y
CONFIG_DM_SERIAL=y
CONFIG_DEBUG_UART_MTK=y
CONFIG_DEBUG_UART_ANNOUNCE=y
CONFIG_MTK_SERIAL=y
#CONFIG_WDT=y
#CONFIG_WDT_MTK=y
CONFIG_CLK=y
CONFIG_TIMER=y
CONFIG_MTK_TIMER=y
CONFIG_CMD_MMC=y
CONFIG_DM_MMC=y
CONFIG_MMC_MTK=y
CONFIG_MMC_HS200_SUPPORT=y
CONFIG_ENV_IS_IN_MMC=y
CONFIG_SPL_DM_SEQ_ALIAS=y
CONFIG_ENV_VARS_UBOOT_RUNTIME_CONFIG=y
CONFIG_LOG=y
CONFIG_LOGLEVEL=7
```

## gplrelease/drivers/misc/mediatek/pmic/fiti/Kconfig
```kconfig
config PMIC_FITI
	bool "enable panel side pmic control driver"
	help
	    PMIC_FITI Module control Fiti PMIC signal,
	    This pmic is only used for controlling the panel power on /off sequence.
	    The Fiti will control panel power sequence.
```

## gplrelease/tools/fit-image.its
```
/dts-v1/;

/ {
        description = "U-Boot fitImage for Mediatek SOC";
        #address-cells = <1>;

        images {
                uboot@1 {
                        description = "U-Boot";
                        data = /incbin/("../u-boot-dtb.bin");
                        type = "uboot";
                        arch = "arm";
                        os = "linux";
                        compression = "none";
                        load = <0x40008000>;
                        entry = <0x40008000>;
                        hash@1 {
                                algo = "sha256";
                        };
                };
        };

        configurations {
                default = "conf@1";
                conf@1 {
                        description = "u-boot configuration";
                        uboot = "uboot@1";
                        signature@1 {
                                algo = "sha256,rsa2048";
                                key-name-hint="dev";
                                sign-images="fdt","uboot";
                        };
                };
        };
};
```

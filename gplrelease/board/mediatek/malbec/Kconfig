## gplrelease/board/mediatek/malbec/Kconfig
```kconfig
if TARGET_MALBEC

config SYS_BOARD
	default "malbec"

config SYS_CONFIG_NAME
	default "malbec"


config MTK_BROM_HEADER_INFO
	string
	default "media=nor"

endif
```

## gplrelease/board/mediatek/malbec8113/Kconfig
```kconfig
if TARGET_MALBEC

config SYS_BOARD
	default "malbec8113"

config SYS_CONFIG_NAME
	default "malbec8113"


config MTK_BROM_HEADER_INFO
	string
	default "media=nor"

endif
```

## gplrelease/board/mediatek/mt8110_bellatrix/Kconfig
```kconfig
if TARGET_MT8110_BELLATRIX

config SYS_BOARD
	default "mt8110_bellatrix"

config SYS_CONFIG_NAME
	default "mt8110_bellatrix"


config MTK_BROM_HEADER_INFO
	string
	default "media=nor"

endif
```

## gplrelease/board/mediatek/mt8110_p2_d3/Kconfig
```kconfig
if TARGET_MT8110_P2_D3

config SYS_BOARD
	default "mt8110_p2_d3"

config SYS_CONFIG_NAME
	default "mt8110_p2_d3"


config MTK_BROM_HEADER_INFO
	string
	default "media=nor"

endif
```

## gplrelease/board/mediatek/mt8113_p2_d2/Kconfig
```kconfig
if TARGET_MT8113_P2_D2

config SYS_BOARD
	default "mt8113_p2_d2"

config SYS_CONFIG_NAME
	default "mt8113_p2_d2"


config MTK_BROM_HEADER_INFO
	string
	default "media=nor"

endif
```

## gplrelease/board/mediatek/mt8113_p2_d3/Kconfig
```kconfig
if TARGET_MT8113_P2_D3

config SYS_BOARD
	default "mt8113_p2_d3"

config SYS_CONFIG_NAME
	default "mt8113_p2_d3"


config MTK_BROM_HEADER_INFO
	string
	default "media=nor"

endif
```

## gplrelease/cmd/eink/Kconfig
```kconfig
menu "EINK command line interface"

config CMD_HWID
	bool "hwid - get HWID"
	default y
	help
	  hwid support.

config CMD_BOOTEINK
	bool "booteink - boot eink fit image"
	default y
	help
	  booteink command to boot eink fit boot image.

config CMD_PROVISION
	bool "provision - device provision"
	default y
	help
	  device provision.

config CMD_UTEST
        bool "utest - factory test suite"
	depends on TARGET_MT8110_BELLATRIX
        default y
        help
          factory test suite support.

endmenu
```

## gplrelease/common/eink/Kconfig
```kconfig
menu "EINK common library"

config UFBL
    bool "UFBL Library"
    help
      This library provides UFBL support.

config FRONTLIGHT
	bool "control frontlight"
	depends on DM_BACKLIGHT
	default y
	help
	  frontlight support.

config DTB_SETUP
	bool "eink device tree blob setup"
	default y
	select OF_BOARD_SETUP
	help
	  functions to setup eink dtb

config HIBERNATION
	bool "eink hibernation"
	default n
	select MISCDATA
	help
		eink hibernation support

config MISCDATA
	bool "eink misc data partition util"
	default n
	help
	  eink misc partition util

config MISCDATA_PARTITION
	string "misc data partition"
	default "miscdata"
	help
	  partition name of misc data

config MISCDATA_FS
	bool "filesystem in misc data partition"
	default n
	depends on MISCDATA
	help
		use filesystem for misc data partition

config HIBERNATION_FALCON
	bool "falcon hibernation functions"
	default n
	depends on FALCON
	help
	  falcon hibernation functions support.

config EINK_DISPLAY
	bool "eink display functions"
	default n
	depends on MTK_HWTCON_SUPPORT
	help
	  eink eink display functions support.

endmenu
```

## gplrelease/configs/mt8110_bellatrix_defconfig
```kconfig
CONFIG_ARM=y
CONFIG_ARM_SMCCC=y
CONFIG_ARCH_MEDIATEK=y
CONFIG_SYS_TEXT_BASE=0x44e00000
CONFIG_SYS_MALLOC_F_LEN=0x4000
CONFIG_TARGET_MT8110_BELLATRIX=y
CONFIG_FALCON=y
CONFIG_FALCON_BIOS_ADDR=0xdf9a0000
CONFIG_FALCON_BIOS_SIZE=0x50000
CONFIG_FALCON_STORAGE_BIOS_ADDR=0xdf980000
CONFIG_FALCON_STORAGE_BIOS_SIZE=0x20000
CONFIG_LPAE=y
CONFIG_KERNEL_LOWMEM_SIZE=0x20000000
CONFIG_NR_DRAM_BANKS=1
# CONFIG_ANDROID_BOOT_IMAGE is not set
CONFIG_FIT=y
CONFIG_FIT_SIGNATURE=y
# CONFIG_ARCH_FIXUP_FDT_MEMORY is not set
CONFIG_DISABLE_CONSOLE=y
CONFIG_DEFAULT_FDT_FILE="mt8110-bellatrix.dtb"
CONFIG_BOARD_LATE_INIT=y
CONFIG_EINK=y
CONFIG_ARCH_MISC_INIT=y
CONFIG_UFBL=y
CONFIG_HIBERNATION=y
CONFIG_HIBERNATION_FALCON=y
CONFIG_EINK_DISPLAY=y
CONFIG_SYS_PROMPT="MT8110> "
CONFIG_CMD_BOOTMENU=y
CONFIG_CMD_MEMINFO=y
CONFIG_CMD_MEMTEST=y
CONFIG_CMD_ADC=y
CONFIG_CMD_GPIO=y
CONFIG_CMD_GPT=y
# CONFIG_RANDOM_UUID is not set
CONFIG_CMD_I2C=y
CONFIG_CMD_MMC=y
CONFIG_CMD_CACHE=y
CONFIG_CMD_CONSYS=y
CONFIG_DEFAULT_DEVICE_TREE="mt8110-bellatrix"
# CONFIG_NET is not set
CONFIG_REGMAP=y
CONFIG_SYSCON=y
CONFIG_MT_AUXADC=y
CONFIG_CLK=y
CONFIG_USB_FUNCTION_FASTBOOT=y
CONFIG_FASTBOOT_BUF_ADDR=0x47000000
CONFIG_FASTBOOT_BUF_SIZE=0x1e00000
CONFIG_FASTBOOT_FLASH=y
CONFIG_FASTBOOT_FLASH_MMC_DEV=0
CONFIG_DM_GPIO=y
CONFIG_DM_I2C=y
CONFIG_DM_I2C_GPIO=y
CONFIG_MTK_I2C=y
CONFIG_DM_MMC=y
# CONFIG_MMC_HW_PARTITIONING is not set
CONFIG_SUPPORT_EMMC_RPMB=y
CONFIG_MMC_HS200_SUPPORT=y
CONFIG_MMC_MTK=y
CONFIG_PHY=y
CONFIG_PHY_MTK_TPHY=y
CONFIG_PINCTRL=y
CONFIG_PINCONF=y
CONFIG_PINCTRL_MT8512=y
CONFIG_DM_PMIC=y
CONFIG_PMIC_BD71828=y
CONFIG_CHARGER_DET_MAX20342=y
CONFIG_RAM=y
CONFIG_BAUDRATE=921600
CONFIG_DM_SERIAL=y
CONFIG_MTK_SERIAL=y
CONFIG_DM_THERMAL=y
CONFIG_MTK_THERMAL=y
CONFIG_TIMER=y
CONFIG_MTK_TIMER=y
CONFIG_USB=y
CONFIG_DM_USB=y
CONFIG_DM_USB_GADGET=y
CONFIG_USB_MTU3=y
CONFIG_USB_GADGET=y
CONFIG_USB_GADGET_MANUFACTURER="MediaTek"
CONFIG_USB_GADGET_VENDOR_NUM=0x0e8d
CONFIG_USB_GADGET_PRODUCT_NUM=0x201c
CONFIG_DM_BACKLIGHT=y
CONFIG_BACKLIGHT_LM3692X=y
CONFIG_BACKLIGHT_FP9966=y
CONFIG_WDT=y
CONFIG_WDT_MTK=y
CONFIG_MTK_HWTCON_SUPPORT=y
CONFIG_MTK_KEDUMP_MINI_SUPPORT=y
CONFIG_MTK_AEE_SAVE_DEBUGINFO_RESERVED_BUFFER=y
CONFIG_FS_FAT=y
CONFIG_LZ4=y
CONFIG_LZMA=y
CONFIG_LZO=y
```

## gplrelease/configs/mt8110_p1_falcon_emmc_defconfig
```kconfig
CONFIG_ARM=y
CONFIG_POSITION_INDEPENDENT=y
CONFIG_ARCH_MEDIATEK=y
CONFIG_SYS_TEXT_BASE=0x44e00000
CONFIG_SYS_MALLOC_F_LEN=0x4000
CONFIG_TARGET_MT8110_P1=y
CONFIG_SYS_PROMPT="MT8110> "
CONFIG_NR_DRAM_BANKS=1
CONFIG_ARCH_MISC_INIT=y
CONFIG_FIT=y
CONFIG_FIT_SIGNATURE=y
CONFIG_OF_LIBFDT=y
# CONFIG_FDT_DEBUG is not set
CONFIG_LZMA=y
CONFIG_LZ4=y
CONFIG_LZO=y
CONFIG_GZIP=y
CONFIG_BZIP2=y
CONFIG_CMD_BOOTMENU=y
CONFIG_MENU_SHOW=y
CONFIG_DEFAULT_FDT_FILE="mt8110-p1-emmc.dtb"
CONFIG_DEFAULT_DEVICE_TREE="mt8110-p1-emmc"
CONFIG_PINCTRL=y
CONFIG_PINCTRL_MT8512=y
CONFIG_PINCONF=y
CONFIG_RAM=y
CONFIG_BAUDRATE=921600
CONFIG_REGMAP=y
CONFIG_SYSCON=y
CONFIG_DM=y
# CONFIG_DM_DEBUG is not set
CONFIG_DM_SERIAL=y
CONFIG_MTK_SERIAL=y
CONFIG_WDT=y
CONFIG_WDT_MTK=y
CONFIG_CLK=y
CONFIG_TIMER=y
CONFIG_MTK_TIMER=y
CONFIG_CMD_MMC=y
CONFIG_DM_MMC=y
CONFIG_MMC_MTK=y
CONFIG_MMC_HS200_SUPPORT=y
# CONFIG_ENV_IS_IN_MMC is not set
CONFIG_FALCON=y
CONFIG_FALCON_BIOS_ADDR=0xdf9a0000
CONFIG_FALCON_BIOS_SIZE=0x50000
CONFIG_FALCON_STORAGE_BIOS_ADDR=0xdf980000
CONFIG_FALCON_STORAGE_BIOS_SIZE=0x20000
CONFIG_LPAE=y
CONFIG_CMD_CACHE=y
```

## gplrelease/configs/mt8110_p2_d2_emmc_defconfig
```kconfig
CONFIG_ARM=y
CONFIG_POSITION_INDEPENDENT=y
CONFIG_ARCH_MEDIATEK=y
CONFIG_SYS_TEXT_BASE=0x44e00000
CONFIG_SYS_MALLOC_F_LEN=0x4000
CONFIG_TARGET_MT8110_P2_D2=y
CONFIG_SYS_PROMPT="MT8110> "
CONFIG_NR_DRAM_BANKS=1
CONFIG_ARCH_MISC_INIT=y
CONFIG_FIT=y
CONFIG_FIT_SIGNATURE=y
CONFIG_OF_LIBFDT=y
# CONFIG_FDT_DEBUG is not set
CONFIG_LOGLEVEL=8
CONFIG_LZMA=y
CONFIG_LZ4=y
CONFIG_LZO=y
CONFIG_GZIP=y
CONFIG_BZIP2=y
CONFIG_CMD_BOOTMENU=y
CONFIG_CMD_PART=y
CONFIG_EFI_PARTITION=y
CONFIG_MENU_SHOW=y
CONFIG_DEFAULT_FDT_FILE="mt8110-p2-d2-emmc.dtb"
CONFIG_DEFAULT_DEVICE_TREE="mt8110-p2-d2-emmc"
CONFIG_CMD_GPIO=y
CONFIG_DM_GPIO=y
CONFIG_PINCTRL=y
CONFIG_PINCTRL_MT8512=y
CONFIG_PINCONF=y
CONFIG_ADC=y
CONFIG_MT_AUXADC=y
CONFIG_CMD_ADC=y
CONFIG_RAM=y
CONFIG_BAUDRATE=921600
CONFIG_REGMAP=y
CONFIG_SYSCON=y
CONFIG_DM=y
CONFIG_BOARD_LATE_INIT=y
CONFIG_MTK_KEDUMP_MINI_SUPPORT=y
CONFIG_MTK_AEE_SAVE_DEBUGINFO_RESERVED_BUFFER=y
CONFIG_USB_FUNCTION_FASTBOOT=y
CONFIG_FASTBOOT_BUF_ADDR=0x47000000
CONFIG_FASTBOOT_BUF_SIZE=0x1e00000
CONFIG_FASTBOOT_FLASH=y
CONFIG_FASTBOOT_FLASH_MMC=y
CONFIG_FASTBOOT_FLASH_MMC_DEV=0
CONFIG_FASTBOOT_MMC_BOOT1_SUPPORT=y
# CONFIG_DM_DEBUG is not set
CONFIG_CMD_I2C=y
CONFIG_DM_I2C=y
CONFIG_MTK_I2C=y
CONFIG_PHY=y
CONFIG_PHY_MTK_TPHY=y
CONFIG_PMIC_BD71828=y
CONFIG_DM_REGULATOR=y
CONFIG_DM_PMIC=y
CONFIG_DM_SERIAL=y
CONFIG_MTK_SERIAL=y
CONFIG_WDT=y
CONFIG_WDT_MTK=y
CONFIG_CLK=y
CONFIG_TIMER=y
CONFIG_MTK_TIMER=y
CONFIG_CMD_MMC=y
CONFIG_DM_MMC=y
CONFIG_MMC_MTK=y
CONFIG_MMC_HS200_SUPPORT=y
CONFIG_USB=y
CONFIG_DM_USB=y
CONFIG_DM_USB_GADGET=y
CONFIG_USB_MTU3=y
CONFIG_USB_MTU3_GADGET=y
CONFIG_USB_GADGET=y
CONFIG_USB_GADGET_MANUFACTURER="MediaTek"
CONFIG_USB_GADGET_VENDOR_NUM=0x0e8d
CONFIG_USB_GADGET_PRODUCT_NUM=0x201c
# CONFIG_ENV_IS_IN_MMC is not set
CONFIG_CMD_MEMORY=y
CONFIG_CMD_MEMTEST=y
CONFIG_CMD_MEMINFO=y
CONFIG_CMD_CONSYS=y
CONFIG_CMD_LPM=y
CONFIG_ARM_SMCCC=y
CONFIG_MTK_THERMAL=y
CONFIG_DM_THERMAL=y
CONFIG_CMD_EXT4=y
CONFIG_CMD_FAT=y
CONFIG_CMD_FS_GENERIC=y
CONFIG_MTK_HWTCON_SUPPORT=y
```

## gplrelease/drivers/aee/Kconfig
```kconfig
#
# aee drivers configuration
#

config MTK_KEDUMP_MINI_SUPPORT
	bool "Enable mini dump feature"
	help
	  Enable minidump feature in uboot, when exception happends in
	  kernel layer, will dump some information to AEE db.

choice
        prompt "Flash provider for kedump"
        depends on MTK_KEDUMP_MINI_SUPPORT

config MTK_KEDUMP_FLASH_MMC
        bool "kedump on MMC"
        depends on MMC

config MTK_KEDUMP_FLASH_NAND
        bool "kedump on NAND"
        depends on NAND && CMD_MTDPARTS

config MTK_AEE_SAVE_DEBUGINFO_RESERVED_BUFFER
        bool "kedump platform debuginfo to reserved buffer"

endchoice
```

## gplrelease/drivers/hwtcon/Kconfig
```kconfig
#
# hwtcon drivers configuration
#

config MTK_HWTCON_SUPPORT
	bool "Enable hwtcon driver"
	help
	  hwtcon driver for display image.
```

## gplrelease/drivers/misc/mediatek/hwtcon/Kconfig
```kconfig
config MTK_HWTCON
	tristate "build HWTCON driver"
	help
	    This HWTCON module is used for drive electronic ink screen show picture.
		    HWTCON will convert Y4 format input picture to electronic conversion signal,
		    which will drive ink screen show input picture.

config CUSTOM_KERNEL_EDP
	string "define mediatek kernel EDP driver"
	help
	  To choose kernel EDP driver name.
	  This config is to select which EDP driver you want to use.
```

## gplrelease/drivers/power/supply/wpc/Kconfig
```kconfig
menuconfig WIRELESS_POWER_CHARGING
	bool "Wireless power charging support"
	help
	  Say Y here to enable wireless power charging support.

if WIRELESS_POWER_CHARGING

config WPC_IDTP922X
	tristate "idtp922X wireless power driver"
	depends on I2C
	default n
	help
		Say Y here to enable support for the idtp922X wireless power.

endif # WIRELESS_POWER_CHARGING
```

## gplrelease/drivers/usb/mtu3/Kconfig
```kconfig
# SPDX-License-Identifier: GPL-2.0
#
# For MTK USB3.0 IP

config USB_MTU3
	bool "MediaTek USB3 Dual Role controller"
	depends on USB || USB_GADGET
	depends on ARCH_MEDIATEK
	select USB_XHCI_MTK if USB_SUPPORT && USB_XHCI_HCD
	help
	  Say Y here if your system runs on MediaTek SoCs with
	  Dual Role SuperSpeed USB controller. You can select usb
	  mode as peripheral role or host role.

	  If you don't know what this is, please say N.

if USB_MTU3
choice
	bool "MTU3 Mode Selection"
	default USB_MTU3_GADGET if USB_GADGET
	default USB_MTU3_HOST if (USB && !USB_GADGET)

config USB_MTU3_HOST
	bool "Host only mode"
	depends on USB=y || USB=USB_MTU3
	help
	  Select this when you want to use MTU3 in host mode only,
	  thereby the gadget feature will be regressed.

config USB_MTU3_GADGET
	bool "Gadget only mode"
	depends on USB_GADGET=y || USB_GADGET=USB_MTU3
	select USB_GADGET_DUALSPEED
	help
	  Select this when you want to use MTU3 in gadget mode only,
	  thereby the host feature will be regressed.

endchoice

config USB_MTU3_DEBUG
	bool "Enable Debugging Messages"
	help
	  Say Y here to enable debugging messages in the MTU3 Driver.

endif
```
